## meta-cattertainment/conf/layer.conf
```bitbake
# We have a conf and classes directory, add to BBPATH
BBPATH .= ":${LAYERDIR}"

# We have recipes-* directories, add to BBFILES
BBFILES += "${LAYERDIR}/recipes-*/*/*.bb \\
            ${LAYERDIR}/recipes-*/*/*.bbappend"

BBFILE_COLLECTIONS += "meta-cattertainment"
BBFILE_PATTERN_meta-cattertainment := "^${LAYERDIR}/"
BBFILE_PRIORITY_meta-cattertainment = "10"

# Optional: Set compatibility with specific Yocto Project releases
LAYERSERIES_COMPAT_meta-cattertainment = "scarthgap"
```
